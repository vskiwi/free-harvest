## main/Kconfig.projbuild
```kconfig
menu "Free Harvest Adapter"

choice HR_BOARD
    prompt "Target board"
    default HR_BOARD_DEVKITC
    help
        Which board the firmware is built for. The protocol, web UI, MQTT
        and capture log are identical on every board; the choice only adds
        the peripherals a particular board carries. The default keeps the
        build exactly as it always was for a bare ESP32-S3 DevKitC.

config HR_BOARD_DEVKITC
    bool "ESP32-S3 DevKitC-1 (no display, no LED, no button)"

config HR_BOARD_T_DONGLE_S3
    bool "LilyGo T-Dongle-S3 (0.96\" ST7735 LCD, APA102 LED, BOOT button)"
    help
        USB-A stick with an 80x160 colour LCD, one RGB LED and one button.
        Note the board has a single USB port that TinyUSB takes over for the
        dryer, so the serial console is only reachable on UART0 (GPIO43/44,
        the QWIIC connector on recent revisions) or through /api/log.

endchoice

config HR_DISPLAY
    bool "Status display on the on-board LCD"
    depends on HR_BOARD_T_DONGLE_S3
    default y
    help
        Show the cycle phase, temperature, vacuum and connection state on the
        LCD. Purely an output: nothing on the display path can send a frame
        to the dryer.

config HR_LED
    bool "Mirror the state on the RGB LED"
    depends on HR_BOARD_T_DONGLE_S3
    default y
    help
        Colour = phase, blink/breathe = attention needed. Brightness is capped
        at 30 % because the LED sits inside a closed case next to the antenna.

config HR_BUTTON
    bool "Use the BOOT button to switch screens / toggle the backlight"
    depends on HR_BOARD_T_DONGLE_S3
    default y
    help
        Short press: dismiss an alert, or cycle main -> info -> raw frame.
        Long press (1.5 s): backlight and LED off/on. The button never sends
        anything to the dryer - a stray press on a stick protruding from the
        machine must not be able to start or stop a batch.

config HR_UI_ROTATION_180
    bool "Rotate the display 180 degrees"
    depends on HR_DISPLAY
    default n
    help
        The default orientation reads correctly with the USB plug on the
        left. Enable this if the dryer's port puts the stick in upside down.

config HR_AP_SSID
    string "Setup access-point SSID"
    default "HR-Adapter-Setup"
    help
        SSID broadcast when no WiFi credentials are stored (or the stored
        network can't be joined). Connect to it to reach the setup page.

config HR_AP_PASSWORD
    string "Setup access-point password (blank = open)"
    default ""
    help
        Password for the setup AP. Leave blank for an open network. If set,
        must be at least 8 characters (WPA2 requirement).

config HR_WIFI_NOIP_DHCP_RESTART_S
    int "No-IP watchdog: restart the DHCP client after (seconds)"
    range 5 600
    default 15
    help
        A station can stay associated - beacons, RSSI, no disconnect event -
        after its DHCP lease expires and the router stops answering renewals;
        lwIP then sits at 0.0.0.0 broadcasting DISCOVER. Once the station
        has been associated without an address for this long, the DHCP
        client is stopped and started so it begins from a clean state.
        Must be shorter than HR_WIFI_NOIP_RECONNECT_S to matter. The status
        (web UI, /api/state, the dryer's WIFIINFO) reports "no-ip" instead
        of "connected" after 5 s regardless.

config HR_WIFI_NOIP_RECONNECT_S
    int "No-IP watchdog: leave and rejoin the network after (seconds)"
    range 10 3600
    default 45
    help
        If restarting DHCP did not bring an address back, the station
        disconnects and reconnects so both the association and DHCP start
        afresh. While the address stays missing the wait doubles on each
        rejoin (45, 90, 180 s ...) up to HR_WIFI_NOIP_RECONNECT_MAX_S, and
        resets as soon as an address is obtained. The setup AP is NOT
        re-opened by these rejoins.

config HR_WIFI_NOIP_RECONNECT_MAX_S
    int "No-IP watchdog: longest wait between rejoins (seconds)"
    range 10 7200
    default 360
    help
        Cap for the doubling back-off above. Bounds how often a network
        that never hands out an address is rejoined: at most once per this
        many seconds, forever - the adapter is powered by the dryer and
        must find its way back on its own.

config HR_ACK_PAYLOAD
    string "GOTIT ack payload (UNVERIFIED)"
    default "ESP32ADAPTER"
    help
        Value sent in the GOTIT acknowledgement. The genuine adapter's
        payload is not yet known - capture it with a USB sniffer and set it
        here (or leave for later; the decoding UI works regardless).

config HR_COMPAT_644170
    bool "Handshake for dryer firmware 6.0.644170 (default at first boot)"
    default n
    help
        Send "UNIQUE lH" instead of a bare "UNIQUE", and re-send FDNAME /
        REQCFG / STATUS on every 15 s heartbeat until each is answered -
        the genuine adapter's observed behaviour.

        A dryer on 6.0.644170 answers a bare UNIQUE with UID and then never
        sends anything else (no SNM, CFG, STAT). That build adds an
        adapter-mode byte that its UNIQUE handler sets only when the frame
        carries "lH"; 6.0.641041 has no such byte and works either way.
        Verified harmless on 6.0.641041.

        This is only the value used until the switch is changed at runtime
        (Settings > Debug, or POST /api/compat), which is stored in NVS.

config HR_BATCH_HISTORY
    bool "Batch history: read the dryer's own batch logs (FDFILES / FILEREAD)"
    default y
    help
        The dryer keeps a CSV log of every batch on its own drive, a row a
        minute, including the ambient thermocouple that no live frame carries.
        With this on, Settings > Batch history lists those files and reads one
        over the same USB link, and the browser charts it.

        Reads only: both verbs are already in the safe set, every name and
        pattern is checked before it can reach the wire, and nothing here can
        start, stop or change a run. A transfer runs in the background - the
        bytes go to the browser as they arrive and nothing is stored on the
        adapter - and is refused while a batch is running unless the request
        asks to go ahead anyway.

        Costs about 2 KB of static RAM for the frame side buffer, plus 8 KB of
        heap for as long as a transfer lasts.

config HR_BATCH_HISTORY_DEFAULT_ON
    bool "Batch history: switched on at first boot"
    depends on HR_BATCH_HISTORY
    default y
    help
        What the runtime switch (Settings > Batch history, kept in NVS) reads
        before anyone changes it. On or off, nothing is sent to the dryer
        until someone asks for a listing or a file.

config HR_HTTP_LOG_TO_UART
    bool "Also echo received frames to the UART console"
    default y

config HR_LOG_RING_KB
    int "In-app log ring (/api/log) size, KB"
    range 4 128
    default 32
    help
        Static DRAM reserved for the in-app copy of the ESP-IDF log that
        /api/log serves. Lines are stored packed (a line costs its own
        length plus two bytes), so 32 KB keeps roughly 500 lines of the
        ~65-character average - a boot, the handshake and several minutes
        of a busy link. Boards without PSRAM that carry other RAM users can
        turn this down; the ring only ever drops its oldest lines.

config HR_CAPTURE_RAW
    bool "Capture log: keep every frame verbatim (no repeat collapsing)"
    default n
    help
        By default consecutive identical frames (an idle dryer's REQINFO
        every 10 s) are collapsed into one "repeat ... xN" summary line to
        save flash. Enable this when recording traffic for protocol work,
        where the exact cadence of every frame matters more than space.
        On a 16 MB board the 11.9 MB capture partition holds several days
        of raw traffic even so.

endmenu
```
